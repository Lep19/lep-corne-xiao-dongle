## config/boards/shields/chipper/Kconfig.defconfig
```kconfig
# Copyright (c) 2020 The ZMK Contributors
# SPDX-License-Identifier: MIT

if SHIELD_CHIPPER_DONGLE

config ZMK_KEYBOARD_NAME
	default "Chipper Dongle"
	
config ZMK_SPLIT_BLE_ROLE_CENTRAL
	default y
	
config ZMK_USB
	default y

endif

if SHIELD_CHIPPER_LEFT || SHIELD_CHIPPER_RIGHT || SHIELD_CHIPPER_DONGLE 

config ZMK_SPLIT
	default y

config ZMK_BLE
	default y
	
endif
```
